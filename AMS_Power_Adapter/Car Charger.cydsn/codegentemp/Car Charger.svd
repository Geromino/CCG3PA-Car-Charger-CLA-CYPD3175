# CYPD3175_24LQXQ register map
File version: 0.1
CCG3PA
Registers are 32-bit, read-write, no defined reset value unless marked. A register's access mark holds for its fields unless they carry their own. Offsets are from the block's base; lines under a group give offsets from that group; [hi:lo] are bit positions; {n}, {i} and the like mark numbered series; 'fields as' and 'values as' point back to an identical list; <NAME> marks a mode.

## Memory map
0x00000000 PWM_A

## PWM_A
Base 0x00000000
0x40090108 COUNTER — Current counter value
0x4009010C CC — Compare / capture value
0x40090110 CC_BUF — Compare / capture buffer value
0x40090114 PERIOD — Period value
0x40090118 PERIOD_BUF — Period buffer value
